## package/kubos/kubos-core/kubos-core-shell/Config.in
```kconfig
menuconfig BR2_PACKAGE_KUBOS_CORE_SHELL
    bool "Shell Service"
    default n
    select BR2_PACKAGE_HAS_KUBOS_CORE_SHELL
    help
        Include Kubos shell service.

if BR2_PACKAGE_KUBOS_CORE_SHELL

config BR2_KUBOS_CORE_SHELL_INIT_LVL
    int "Shell Service Init Level"
    default 90
    range 10 99
    depends on BR2_PACKAGE_KUBOS_CORE_SHELL
    help
        The initialization priority level of the shell service.
        The lower the number, the earlier the service is initialized.

config BR2_KUBOS_CORE_SHELL_RESTART_COUNT
    int "Shell Service Restart Limit"
    default 3
    depends on BR2_PACKAGE_KUBOS_CORE_SHELL
    depends on BR2_PACKAGE_MONIT
    help
        The maximum number of times the service should be restarted within the timeframe
        specified by BR2_KUBOS_CORE_SHELL_RESTART_CYCLES if it goes down

config BR2_KUBOS_CORE_SHELL_RESTART_CYCLES
    int "Shell Service Restart Limit Timeframe"
    default 10
    depends on BR2_PACKAGE_KUBOS_CORE_SHELL
    depends on BR2_PACKAGE_MONIT
    help
        The number of Monit monitoring cycles in which the maximum number of service restarts
        must occur before the system stops trying to recover the service.
        
        The resulting maximum timeframe in which the restarts must occur can be calculated by
        multiplying this number by the length of a single Monit sleep cycle (60 seconds)

config BR2_KUBOS_CORE_SHELL_IP
    string "Shell Service IP Address"
    default "0.0.0.0"
    depends on BR2_PACKAGE_KUBOS_CORE_SHELL
    help
        The IP address which the shell service should use for communication
        
config BR2_KUBOS_CORE_SHELL_PORT
    int "Shell Service Port"
    default 8050
    depends on BR2_PACKAGE_KUBOS_CORE_SHELL
    help
        The port which the shell service should use to receive UDP messages
        
endif

config BR2_PACKAGE_HAS_KUBOS_CORE_SHELL
    bool

config BR2_PACKAGE_PROVIDES_KUBOS_CORE_SHELL
    string
    default "kubos"
```
