## package/kubos-command-and-control/Config.in
```kconfig
config BR2_PACKAGE_KUBOS_COMMAND_AND_CONTROL
	bool "command_and_control"
	default y
	help
		Include KubOS Linux Command and Control service.
		This service allows for running commands
		through the command and control daemon.

config BR2_KUBOS_COMMAND_AND_CONTROL_INIT_LVL
	int "Command and Control Run Level"
	default 70
	range 10 99
	depends on BR2_PACKAGE_KUBOS_COMMAND_AND_CONTROL
	help
		The initialization priority level of the KubOS Linux
		command and control service.  The lower the number,
		the earlierthe service is initialized.
```

## package/kubos-telemetry/Config.in
```kconfig
config BR2_PACKAGE_KUBOS_TELEMETRY
	bool "Telemetry"
	default y
	help
		Include KubOS Linux telemetry service.
		This service is vital for inter-system communication
		and should not be turned off!
```

## package/kubos/Config.in
```kconfig
menuconfig BR2_PACKAGE_KUBOS
	bool "Kubos Packages"
	default y
	help
		Enable Kubos services and libraries

if BR2_PACKAGE_KUBOS
	
	config BR2_KUBOS_VERSION
		string "Kubos Source Version"
		default "master"
		help
			Release, tag, or branch of the Kubos repo to use when building Kubos
			packages

    
    source "$BR2_EXTERNAL_KUBOS_LINUX_PATH/package/kubos/kubos-core/Config.in"
    source "$BR2_EXTERNAL_KUBOS_LINUX_PATH/package/kubos/kubos-monitor/Config.in"
    source "$BR2_EXTERNAL_KUBOS_LINUX_PATH/package/kubos/kubos-app-api/Config.in"
    source "$BR2_EXTERNAL_KUBOS_LINUX_PATH/package/kubos/kubos-hal-i2c/Config.in"
    source "$BR2_EXTERNAL_KUBOS_LINUX_PATH/package/kubos/kubos-service-lib/Config.in"
    
    source "$BR2_EXTERNAL_KUBOS_LINUX_PATH/package/kubos/kubos-clyde-3g-eps/Config.in"
    source "$BR2_EXTERNAL_KUBOS_LINUX_PATH/package/kubos/kubos-isis-ants/Config.in"  	
    source "$BR2_EXTERNAL_KUBOS_LINUX_PATH/package/kubos/kubos-mai400/Config.in"
    source "$BR2_EXTERNAL_KUBOS_LINUX_PATH/package/kubos/kubos-novatel-oem6/Config.in"
    source "$BR2_EXTERNAL_KUBOS_LINUX_PATH/package/kubos/kubos-nsl-duplex/Config.in"
    source "$BR2_EXTERNAL_KUBOS_LINUX_PATH/package/kubos/kubos-pumpkin-mcu/Config.in"
    source "$BR2_EXTERNAL_KUBOS_LINUX_PATH/package/kubos/kubos-pumpkin-mcu-api/Config.in"
    source "$BR2_EXTERNAL_KUBOS_LINUX_PATH/package/kubos/kubos-pumpkin-wdt/Config.in"

endif
```

## package/kubos/kubos-app-api/Config.in
```kconfig
config BR2_PACKAGE_KUBOS_APP_API
    bool "Python App API"
    default y
    depends on BR2_PACKAGE_PYTHON3
    select BR2_PACKAGE_PYTHON_TOML
    select BR2_PACKAGE_PYTHON_REQUESTS
    help
        Include the Kubos app API for Python.
        
        This API simplifies the process of communicating with Kubos services.
        It should be included if you intend to write mission applications using Python.
```

## package/kubos/kubos-c2-cli-client/Config.in
```kconfig
config BR2_PACKAGE_KUBOS_C2_CLI_CLIENT
	bool "Command and Control Command Line Client"
	default y
	select BR2_PACKAGE_KUBOS_C2_DAEMON
	help
		Include the command line interface client for interacting with
		the Command and Control daemon.
```

## package/kubos/kubos-clyde-3g-eps/Config.in
```kconfig
menuconfig BR2_PACKAGE_KUBOS_CLYDE_3G_EPS
    bool "ClydeSpace 3G EPS Service"
    default n
    select BR2_PACKAGE_HAS_KUBOS_CLYDE_3G_EPS
    help
        Include ClydeSpace 3G EPS Kubos service.

if BR2_PACKAGE_KUBOS_CLYDE_3G_EPS

config BR2_KUBOS_CLYDE_3G_EPS_INIT_LVL
    int "Service Run Level"
    default 90
    range 10 99
    depends on BR2_PACKAGE_KUBOS_CLYDE_3G_EPS
    help
        The initialization priority level of the ClydeSpace 3G EPS Kubos service.
        The lower the number, the earlier the service is initialized.

config BR2_KUBOS_CLYDE_3G_EPS_RESTART_COUNT
    int "Service Restart Limit"
    default 3
    depends on BR2_PACKAGE_KUBOS_CLYDE_3G_EPS
    depends on BR2_PACKAGE_MONIT
    help
        The maximum number of times the service should be restarted within the timeframe
        specified by BR2_KUBOS_CLYDE_3G_EPS_RESTART_CYCLES if it goes down

config BR2_KUBOS_CLYDE_3G_EPS_RESTART_CYCLES
    int "Service Restart Limit Timeframe"
    default 10
    depends on BR2_PACKAGE_KUBOS_CLYDE_3G_EPS
    depends on BR2_PACKAGE_MONIT
    help
        The number of Monit monitoring cycles in which the maximum number of service restarts
        must occur before the system stops trying to recover the service.
        
        The resulting maximum timeframe in which the restarts must occur can be calculated by
        multiplying this number by the length of a single Monit sleep cycle (60 seconds)

config BR2_KUBOS_CLYDE_3G_EPS_IP
    string "Service IP Address"
    default "0.0.0.0"
    depends on BR2_PACKAGE_KUBOS_CLYDE_3G_EPS
    help
        The IP address which the service should use to receive GraphQL requests
        
config BR2_KUBOS_CLYDE_3G_EPS_PORT
    int "Service Port"
    default 8100
    depends on BR2_PACKAGE_KUBOS_CLYDE_3G_EPS
    help
        The port which the service should use to receive GraphQL requests

config BR2_KUBOS_CLYDE_3G_EPS_BUS
    string "I2C Bus"
    default "/dev/i2c-1"
    depends on BR2_PACKAGE_KUBOS_CLYDE_3G_EPS
    help
        The I2C bus which the EPS device is connected to
        
endif

config BR2_PACKAGE_HAS_KUBOS_CLYDE_3G_EPS
    bool

config BR2_PACKAGE_PROVIDES_KUBOS_CLYDE_3G_EPS
    string
    default "kubos"
```

## package/kubos/kubos-command/Config.in
```kconfig
menuconfig BR2_PACKAGE_KUBOS_COMMAND
	bool "Command and Control"
	default y
	help
		Enable Kubos Command and Control

if BR2_PACKAGE_KUBOS_COMMAND

	source "$BR2_EXTERNAL_KUBOS_LINUX_PATH/package/kubos/kubos-command/kubos-c2-cli-client/Config.in"
	source "$BR2_EXTERNAL_KUBOS_LINUX_PATH/package/kubos/kubos-command/kubos-c2-core-library/Config.in"
	source "$BR2_EXTERNAL_KUBOS_LINUX_PATH/package/kubos/kubos-command/kubos-c2-daemon/Config.in"
endif
```

## package/kubos/kubos-core/Config.in
```kconfig
menuconfig BR2_PACKAGE_KUBOS_CORE
   bool "Kubos Core Services"
   default y
   select BR2_PACKAGE_KUBOS_CORE_APP_SERVICE
   select BR2_PACKAGE_KUBOS_CORE_FILE_TRANSFER
   select BR2_PACKAGE_KUBOS_CORE_SHELL
   select BR2_PACKAGE_KUBOS_CORE_TELEMETRY_DB
   help
       Include the KubOS core services

if BR2_PACKAGE_KUBOS_CORE
    source "$BR2_EXTERNAL_KUBOS_LINUX_PATH/package/kubos/kubos-core/kubos-core-app-service/Config.in"
    source "$BR2_EXTERNAL_KUBOS_LINUX_PATH/package/kubos/kubos-core/kubos-core-file-transfer/Config.in"
    source "$BR2_EXTERNAL_KUBOS_LINUX_PATH/package/kubos/kubos-core/kubos-core-scheduler/Config.in"
    source "$BR2_EXTERNAL_KUBOS_LINUX_PATH/package/kubos/kubos-core/kubos-core-shell/Config.in"
    source "$BR2_EXTERNAL_KUBOS_LINUX_PATH/package/kubos/kubos-core/kubos-core-telemetry-db/Config.in"
endif
```

## package/kubos/kubos-core/kubos-core-app-service/Config.in
```kconfig
menuconfig BR2_PACKAGE_KUBOS_CORE_APP_SERVICE
    bool "Application Service"
    default n
    select BR2_PACKAGE_HAS_KUBOS_CORE_APP_SERVICE
    help
        Include Kubos application service.

if BR2_PACKAGE_KUBOS_CORE_APP_SERVICE

config BR2_KUBOS_CORE_APP_SERVICE_INIT_LVL
    int "App Service Init Level"
    default 90
    range 10 99
    depends on BR2_PACKAGE_KUBOS_CORE_APP_SERVICE
    help
        The initialization priority level of the Kubos application service.
        The lower the number, the earlier the service is initialized.

config BR2_KUBOS_CORE_APP_SERVICE_RESTART_COUNT
    int "App Service Restart Limit"
    default 3
    depends on BR2_PACKAGE_KUBOS_CORE_APP_SERVICE
    depends on BR2_PACKAGE_MONIT
    help
        The maximum number of times the service should be restarted within the timeframe
        specified by BR2_KUBOS_CORE_APP_SERVICE_RESTART_CYCLES if it goes down

config BR2_KUBOS_CORE_APP_SERVICE_RESTART_CYCLES
    int "App Service Restart Limit Timeframe"
    default 10
    depends on BR2_PACKAGE_KUBOS_CORE_APP_SERVICE
    depends on BR2_PACKAGE_MONIT
    help
        The number of Monit monitoring cycles in which the maximum number of service restarts
        must occur before the system stops trying to recover the service.
        
        The resulting maximum timeframe in which the restarts must occur can be calculated by
        multiplying this number by the length of a single Monit sleep cycle (60 seconds)

config BR2_KUBOS_CORE_APP_SERVICE_IP
    string "App Service IP Address"
    default "0.0.0.0"
    depends on BR2_PACKAGE_KUBOS_CORE_APP_SERVICE
    help
        The IP address which the app service should use to receive GraphQL requests
        
config BR2_KUBOS_CORE_APP_SERVICE_PORT
    int "App Service Port"
    default 8000
    depends on BR2_PACKAGE_KUBOS_CORE_APP_SERVICE
    help
        The port which the app service should use to receive GraphQL requests

config BR2_KUBOS_CORE_APP_SERVICE_REGISTRY
    string "App Service Registry Directory"
    default "/home/system/kubos/apps"
    depends on BR2_PACKAGE_KUBOS_CORE_APP_SERVICE
    help
        The directory which the app service should use to store all registry entries

endif

config BR2_PACKAGE_HAS_KUBOS_CORE_APP_SERVICE
    bool

config BR2_PACKAGE_PROVIDES_KUBOS_CORE_APP_SERVICE
    string
    default "kubos"
```

## package/kubos/kubos-core/kubos-core-file-transfer/Config.in
```kconfig
menuconfig BR2_PACKAGE_KUBOS_CORE_FILE_TRANSFER
    bool "File Transfer Service"
    default n
    select BR2_PACKAGE_HAS_KUBOS_CORE_FILE_TRANSFER
    help
        Include Kubos file transfer service.

if BR2_PACKAGE_KUBOS_CORE_FILE_TRANSFER

config BR2_KUBOS_CORE_FILE_TRANSFER_INIT_LVL
    int "File Transfer Service Init Level"
    default 90
    range 10 99
    depends on BR2_PACKAGE_KUBOS_CORE_FILE_TRANSFER
    help
        The initialization priority level of the file transfer service.
        The lower the number, the earlier the service is initialized.
        
config BR2_KUBOS_CORE_FILE_TRANSFER_RESTART_COUNT
    int "File Transfer Service Restart Limit"
    default 3
    depends on BR2_PACKAGE_KUBOS_CORE_FILE_TRANSFER
    depends on BR2_PACKAGE_MONIT
    help
        The maximum number of times the service should be restarted within the timeframe
        specified by BR2_KUBOS_CORE_FILE_TRANSFER_RESTART_CYCLES if it goes down

config BR2_KUBOS_CORE_FILE_TRANSFER_RESTART_CYCLES
    int "File Transfer Service Restart Limit Timeframe"
    default 10
    depends on BR2_PACKAGE_KUBOS_CORE_FILE_TRANSFER
    depends on BR2_PACKAGE_MONIT
    help
        The number of Monit monitoring cycles in which the maximum number of service restarts
        must occur before the system stops trying to recover the service.
        
        The resulting maximum timeframe in which the restarts must occur can be calculated by
        multiplying this number by the length of a single Monit sleep cycle (60 seconds)

config BR2_KUBOS_CORE_FILE_TRANSFER_IP
    string "File Transfer Service IP Address"
    default "0.0.0.0"
    depends on BR2_PACKAGE_KUBOS_CORE_FILE_TRANSFER
    help
        The IP address which the file transfer service should use to receive GraphQL requests
        
config BR2_KUBOS_CORE_FILE_TRANSFER_PORT
    int "File Transfer Service Port"
    default 8040
    depends on BR2_PACKAGE_KUBOS_CORE_FILE_TRANSFER
    help
        The port which the file transfer service should use to receive GraphQL requests
        
config BR2_KUBOS_CORE_FILE_TRANSFER_DOWNLINK_IP
    string "File Transfer Downlink IP Address"
    default "0.0.0.0"
    depends on BR2_PACKAGE_KUBOS_CORE_FILE_TRANSFER
    help
        The IP address which the file transfer service should send responses to
        
config BR2_KUBOS_CORE_FILE_TRANSFER_DOWNLINK_PORT
    int "File Transfer Service Port"
    default 8080
    depends on BR2_PACKAGE_KUBOS_CORE_FILE_TRANSFER
    help
        The port which the file transfer service should send responses to

config BR2_KUBOS_CORE_FILE_TRANSFER_STORAGE
    string "File Transfer Storage Directory"
    default "/home/system/file-storage"
    depends on BR2_PACKAGE_KUBOS_CORE_FILE_TRANSFER
    help
        The directory which the file transfer service should use to store intermediate transfer
        chunks
        
config BR2_KUBOS_CORE_FILE_TRANSFER_CHUNK_SIZE
    int "File Transfer Chunk Size"
    default 1024
    depends on BR2_PACKAGE_KUBOS_CORE_FILE_TRANSFER
    help
        Each file is broken up into equally sized chunks prior to transfer.
        This option specifies the size of those chunks in bytes.
        
config BR2_KUBOS_CORE_FILE_TRANSFER_TIMEOUT
    int "File Transfer Transaction Receive Timeout"
    default 2
    depends on BR2_PACKAGE_KUBOS_CORE_FILE_TRANSFER
    help
        The length of time, in seconds, for which the service should wait for new messages from
        the client once a file protocol transaction has been started

config BR2_KUBOS_CORE_FILE_TRANSFER_HOLD_COUNT
    int "File Transfer Transaction Hold Count"
    default 5
    depends on BR2_PACKAGE_KUBOS_CORE_FILE_TRANSFER
    help
        The number of times the protocol waits for a new message before ending the transaction

endif

config BR2_PACKAGE_HAS_KUBOS_CORE_FILE_TRANSFER
    bool

config BR2_PACKAGE_PROVIDES_KUBOS_CORE_FILE_TRANSFER
    string
    default "kubos"
```

## package/kubos/kubos-core/kubos-core-lua/Config.in
```kconfig
menuconfig BR2_PACKAGE_KUBOS_CORE_LUA
    bool
    default n
    help
        Include the Kubos core services which are written in Lua.
```

## package/kubos/kubos-core/kubos-core-scheduler/Config.in
```kconfig
menuconfig BR2_PACKAGE_KUBOS_CORE_SCHEDULER
    bool "Scheduler Service"
    default y
    select BR2_PACKAGE_HAS_KUBOS_CORE_SCHEDULER
    help
        Include Kubos application service.

if BR2_PACKAGE_KUBOS_CORE_SCHEDULER

config BR2_KUBOS_CORE_SCHEDULER_INIT_LVL
    int "Scheduler Service Init Level"
    default 99
    range 10 99
    depends on BR2_PACKAGE_KUBOS_CORE_SCHEDULER
    help
        The initialization priority level of the Kubos application service.
        The lower the number, the earlier the service is initialized.

config BR2_KUBOS_CORE_SCHEDULER_RESTART_COUNT
    int "Scheduler Service Restart Limit"
    default 3
    depends on BR2_PACKAGE_KUBOS_CORE_SCHEDULER
    depends on BR2_PACKAGE_MONIT
    help
        The maximum number of times the service should be restarted within the timeframe
        specified by BR2_KUBOS_CORE_SCHEDULER_RESTART_CYCLES if it goes down

config BR2_KUBOS_CORE_SCHEDULER_RESTART_CYCLES
    int "Scheduler Service Restart Limit Timeframe"
    default 10
    depends on BR2_PACKAGE_KUBOS_CORE_SCHEDULER
    depends on BR2_PACKAGE_MONIT
    help
        The number of Monit monitoring cycles in which the maximum number of service restarts
        must occur before the system stops trying to recover the service.
        
        The resulting maximum timeframe in which the restarts must occur can be calculated by
        multiplying this number by the length of a single Monit sleep cycle (60 seconds)

config BR2_KUBOS_CORE_SCHEDULER_IP
    string "Scheduler Service IP Address"
    default "0.0.0.0"
    depends on BR2_PACKAGE_KUBOS_CORE_SCHEDULER
    help
        The IP address which the scheduler service should use to receive GraphQL requests
        
config BR2_KUBOS_CORE_SCHEDULER_PORT
    int "Scheduler Service Port"
    default 8010
    depends on BR2_PACKAGE_KUBOS_CORE_SCHEDULER
    help
        The port which the scheduler service should use to receive GraphQL requests

config BR2_KUBOS_CORE_SCHEDULER_REGISTRY
    string "Scheduler Service Storage Directory"
    default "/home/system/kubos/schedules"
    depends on BR2_PACKAGE_KUBOS_CORE_SCHEDULER
    help
        The directory which the scheduler service should use to store all registry entries

endif

config BR2_PACKAGE_HAS_KUBOS_CORE_SCHEDULER
    bool

config BR2_PACKAGE_PROVIDES_KUBOS_CORE_SCHEDULER
    string
    default "kubos"
```
