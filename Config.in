## Config.in
```kconfig
source "$BR2_EXTERNAL_KUBOS_LINUX_PATH/package/kubos/Config.in"
source "$BR2_EXTERNAL_KUBOS_LINUX_PATH/package/python/Config.in"
```

## at91sam9g20kubos/at91sam9g20kubos_defconfig
```kconfig
CONFIG_ARM=y
CONFIG_ARCH_AT91=y
CONFIG_TARGET_AT91SAM9G20KUBOS=y
CONFIG_SYS_EXTRA_OPTIONS="AT91SAM9G20,SYS_USE_NORFLASH"
CONFIG_BOOTDELAY=3
CONFIG_SYS_PROMPT="U-Boot> "
# CONFIG_CMD_BOOTD is not set
CONFIG_CMD_BOOTZ=y
# CONFIG_CMD_ELF is not set
# CONFIG_CMD_IMI is not set
CONFIG_CMD_MEMINFO=y
# CONFIG_CMD_LOADS is not set
CONFIG_CMD_MMC=y
CONFIG_CMD_USB=y
# CONFIG_CMD_FPGA is not set
CONFIG_CMD_GPIO=y
# CONFIG_CMD_SOURCE is not set
# CONFIG_CMD_SETEXPR is not set
# CONFIG_CMD_NET is not set
# CONFIG_CMD_NFS is not set
CONFIG_CMD_EXT2=y
CONFIG_CMD_EXT4=y
CONFIG_CMD_EXT4_WRITE=y
CONFIG_CMD_FAT=y
CONFIG_CMD_FS_GENERIC=y
CONFIG_USB=y
CONFIG_USB_OHCI_HCD=y
CONFIG_USB_STORAGE=y
CONFIG_REGEX=y
CONFIG_OF_LIBFDT=y
# CONFIG_EFI_LOADER is not set
```

## board/kubos/at91sam9g20isis/kernel.its
```
/*
 * Copyright (C) 2017 Kubos Corporation
 *
 * Licensed under the Apache License, Version 2.0 (the "License");
 * you may not use this file except in compliance with the License.
 * You may obtain a copy of the License at
 *
 *     http://www.apache.org/licenses/LICENSE-2.0
 *
 * Unless required by applicable law or agreed to in writing, software
 * distributed under the License is distributed on an "AS IS" BASIS,
 * WITHOUT WARRANTIES OR CONDITIONS OF ANY KIND, either express or implied.
 * See the License for the specific language governing permissions and
 * limitations under the License.
 *
 * KubOS Linux Kernel Package
 * Contains: zImage
 */

/dts-v1/;

/ {
	description = "KubOS Linux Kernel Package";
	#address-cells = <1>;

	images {
		kernel@1 {
			data = /incbin/("./../../../../buildroot-2016.11/output/images/zImage");
			type = "kernel";
			arch = "arm";
			os = "linux";
			compression = "none";
			load = <0x21880000>;
			entry = <0x21880000>;
			hash@1 {
				algo = "crc32";
			};
		};
	};

	configurations {
		default = "config@1";
		config@1 {
			description = "Boot Linux kernel";
			kernel = "kernel@1";
		};
	};
};
```

## board/kubos/at91sam9g20isis/kpack-NOR.its
```
/*
 * Copyright (C) 2017 Kubos Corporation
 *
 * Licensed under the Apache License, Version 2.0 (the "License");
 * you may not use this file except in compliance with the License.
 * You may obtain a copy of the License at
 *
 *     http://www.apache.org/licenses/LICENSE-2.0
 *
 * Unless required by applicable law or agreed to in writing, software
 * distributed under the License is distributed on an "AS IS" BASIS,
 * WITHOUT WARRANTIES OR CONDITIONS OF ANY KIND, either express or implied.
 * See the License for the specific language governing permissions and
 * limitations under the License.
 *
 * Kubos Linux Upgrade Package
 * Contains: New zImage and rootfs image
 */

/dts-v1/;

/ {
	description = "Kubos Bootloader Upgrade Package";
	#address-cells = <1>;

	images {
		dtb@1 {
			data = /incbin/("./../../buildroot-2019.02.2/output/images/at91sam9g20isis.dtb");
			type = "firmware";
			arch = "arm";
			os = "linux";
			compression = "none";
			load = <00000000>;
			entry = <00000000>;
			hash@1 {
				algo = "sha256";
			};
		};
	};

	configurations {
		default = "config@1";
		config@1 {
			description = "Linux Device Tree";
			dtb = "dtb@1";
		};
	};
};
```

## board/kubos/beaglebone-black/kpack.its
```
/*
 * Copyright (C) 2019 Kubos Corporation
 *
 * Licensed under the Apache License, Version 2.0 (the "License");
 * you may not use this file except in compliance with the License.
 * You may obtain a copy of the License at
 *
 *     http://www.apache.org/licenses/LICENSE-2.0
 *
 * Unless required by applicable law or agreed to in writing, software
 * distributed under the License is distributed on an "AS IS" BASIS,
 * WITHOUT WARRANTIES OR CONDITIONS OF ANY KIND, either express or implied.
 * See the License for the specific language governing permissions and
 * limitations under the License.
 *
 * Kubos Linux Upgrade Package
 * Contains: New kernel and rootfs image
 */

/dts-v1/;

/ {
	description = "Kubos Linux Upgrade Package for BBB";
	#address-cells = <1>;

	images {
		kernel@1 {
			data = /incbin/("./kernel");
			type = "firmware";
			arch = "arm";
			os = "linux";
			compression = "none";
			load = <00000000>;
			entry = <00000000>;
			hash@1 {
				algo = "sha256";
			};
		};
		rootfs@1 {
			data = /incbin/("./rootfs.ext2");
			type = "firmware";
			arch = "arm";
			os = "linux";
			compression = "none";
			load = <00000000>;
			entry = <00000000>;
			hash@1 {
				algo = "sha256";
			};
		};
		beaglebone-black.dtb@1 {
			data = /incbin/("./beaglebone-black.dtb");
			type = "firmware";
			arch = "arm";
			os = "linux";
			compression = "none";
			load = <00000000>;
			entry = <00000000>;
			hash@1 {
				algo = "sha256";
			};
		};
	};
};
```

## board/kubos/raspberrypi/kubos-kernel.its
```
/*
 * Copyright (C) 2017 Kubos Corporation
 *
 * Licensed under the Apache License, Version 2.0 (the "License");
 * you may not use this file except in compliance with the License.
 * You may obtain a copy of the License at
 *
 *     http://www.apache.org/licenses/LICENSE-2.0
 *
 * Unless required by applicable law or agreed to in writing, software
 * distributed under the License is distributed on an "AS IS" BASIS,
 * WITHOUT WARRANTIES OR CONDITIONS OF ANY KIND, either express or implied.
 * See the License for the specific language governing permissions and
 * limitations under the License.
 *
 * Kubos Linux Kernel Package
 * Contains: zImage
 */

/dts-v1/;

/ {
	description = "Kubos Linux Kernel";
	#address-cells = <1>;

	images {
		kernel@1 {
			data = /incbin/("./zImage");
			type = "kernel";
			arch = "arm";
			os = "linux";
			compression = "none";
			load = <0x82800000>;
			entry = <0x82800000>;
			hash@1 {
				algo = "sha256";
			};
		};
	};

	configurations {
		default = "config@1";
		config@1 {
			description = "Boot Linux kernel";
			kernel = "kernel@1";
		};
	};
};
```

## configs/at91sam9g20isis_defconfig
```kconfig
BR2_arm=y
BR2_HOST_DIR="/usr/bin/iobc_toolchain"
BR2_GLOBAL_PATCH_DIR="${BR2_EXTERNAL_KUBOS_LINUX_PATH}/common/patches"
BR2_TOOLCHAIN_BUILDROOT_GLIBC=y
BR2_PACKAGE_HOST_LINUX_HEADERS_CUSTOM_4_4=y
BR2_BINUTILS_VERSION_2_31_X=y
BR2_TOOLCHAIN_BUILDROOT_CXX=y
BR2_GCC_ENABLE_LTO=y
BR2_PACKAGE_HOST_GDB=y
BR2_PACKAGE_HOST_GDB_SIM=y
BR2_TARGET_GENERIC_HOSTNAME="Kubos"
BR2_TARGET_GENERIC_ISSUE="Welcome to Kubos Linux"
BR2_ROOTFS_DEVICE_TABLE="system/device_table.txt $(BR2_EXTERNAL)/common/device_table.txt"
BR2_TARGET_GENERIC_ROOT_PASSWD="Kubos123"
BR2_TARGET_GENERIC_GETTY_PORT="ttyS0"
BR2_TARGET_GENERIC_GETTY_BAUDRATE_115200=y
BR2_ROOTFS_USERS_TABLES="${BR2_EXTERNAL_KUBOS_LINUX_PATH}/common/users.txt"
BR2_ROOTFS_OVERLAY="${BR2_EXTERNAL_KUBOS_LINUX_PATH}/common/overlay ${BR2_EXTERNAL_KUBOS_LINUX_PATH}/board/kubos/at91sam9g20isis/overlay"
BR2_ROOTFS_POST_IMAGE_SCRIPT="${BR2_EXTERNAL_KUBOS_LINUX_PATH}/board/kubos/at91sam9g20isis/post-image.sh"
BR2_ROOTFS_POST_SCRIPT_ARGS="${BR2_TARGET_UBOOT_CUSTOM_REPO_VERSION}"
BR2_LINUX_KERNEL=y
BR2_LINUX_KERNEL_CUSTOM_VERSION=y
BR2_LINUX_KERNEL_CUSTOM_VERSION_VALUE="4.4.23"
BR2_LINUX_KERNEL_PATCH="${BR2_EXTERNAL_KUBOS_LINUX_PATH}/board/kubos/at91sam9g20isis/linux/"
BR2_LINUX_KERNEL_USE_CUSTOM_CONFIG=y
BR2_LINUX_KERNEL_CUSTOM_CONFIG_FILE="${BR2_EXTERNAL_KUBOS_LINUX_PATH}/common/linux-kubos.config"
BR2_LINUX_KERNEL_CONFIG_FRAGMENT_FILES="${BR2_EXTERNAL_KUBOS_LINUX_PATH}/board/kubos/at91sam9g20isis/linux-kubos.config"
BR2_LINUX_KERNEL_LZ4=y
BR2_LINUX_KERNEL_DTS_SUPPORT=y
BR2_LINUX_KERNEL_CUSTOM_DTS_PATH="${BR2_EXTERNAL_KUBOS_LINUX_PATH}/board/kubos/at91sam9g20isis/at91sam9g20isis.dts ${BR2_EXTERNAL_KUBOS_LINUX_PATH}/board/kubos/at91sam9g20isis/iobc-common.dtsi"
BR2_LINUX_KERNEL_NEEDS_HOST_OPENSSL=y
BR2_PACKAGE_BUSYBOX_CONFIG="${BR2_EXTERNAL_KUBOS_LINUX_PATH}/common/busybox-kubos.config"
BR2_PACKAGE_BUSYBOX_SHOW_OTHERS=y
BR2_PACKAGE_E2FSPROGS=y
BR2_PACKAGE_E2FSPROGS_DEBUGFS=y
BR2_PACKAGE_SPI_TOOLS=y
BR2_PACKAGE_UBOOT_TOOLS=y
BR2_PACKAGE_UBOOT_TOOLS_FIT_SUPPORT=y
BR2_PACKAGE_UBOOT_TOOLS_MKIMAGE=y
BR2_PACKAGE_OPENSSL=y
BR2_PACKAGE_LIBCURL=y
BR2_PACKAGE_CURL=y
BR2_PACKAGE_DROPBEAR=y
BR2_PACKAGE_DROPBEAR_DISABLE_REVERSEDNS=y
BR2_PACKAGE_IFTOP=y
BR2_PACKAGE_LRZSZ=y
BR2_PACKAGE_MONIT=y
BR2_PACKAGE_RSYSLOG=y
BR2_PACKAGE_UTIL_LINUX_LIBFDISK=y
BR2_PACKAGE_UTIL_LINUX_MOUNT=y
BR2_PACKAGE_UTIL_LINUX_UUIDD=y
BR2_TARGET_ROOTFS_EXT2=y
BR2_TARGET_ROOTFS_EXT2_4=y
BR2_TARGET_ROOTFS_EXT2_LABEL="rootfs"
BR2_TARGET_ROOTFS_EXT2_SIZE="21987K"
BR2_TARGET_ROOTFS_EXT2_LZMA=y
BR2_TARGET_ROOTFS_TAR_LZMA=y
BR2_TARGET_UBOOT=y
BR2_TARGET_UBOOT_BUILD_SYSTEM_KCONFIG=y
BR2_TARGET_UBOOT_CUSTOM_GIT=y
BR2_TARGET_UBOOT_CUSTOM_REPO_URL="https://github.com/kubos/uboot"
BR2_TARGET_UBOOT_CUSTOM_REPO_VERSION="1.5"
BR2_TARGET_UBOOT_USE_CUSTOM_CONFIG=y
BR2_TARGET_UBOOT_CUSTOM_CONFIG_FILE="${BR2_EXTERNAL_KUBOS_LINUX_PATH}/board/kubos/at91sam9g20isis/at91sam9g20isis_config"
BR2_PACKAGE_HOST_DOSFSTOOLS=y
BR2_PACKAGE_HOST_GENEXT2FS=y
BR2_PACKAGE_HOST_GENIMAGE=y
BR2_PACKAGE_HOST_MTOOLS=y
BR2_PACKAGE_HOST_SAM_BA=y

# Temporarily disable including scheduler in iOBC builds
BR2_PACKAGE_KUBOS_CORE_SCHEDULER=n
```

## configs/beagleboneblack_defconfig
```kconfig
BR2_arm=y
BR2_BINUTILS_VERSION_2_27_X=y
BR2_cortex_a8=y
BR2_LINUX_KERNEL=y
BR2_LINUX_KERNEL_CUSTOM_GIT=y
BR2_LINUX_KERNEL_CUSTOM_REPO_URL="git://git.ti.com/processor-sdk/processor-sdk-linux.git"
BR2_LINUX_KERNEL_CUSTOM_REPO_VERSION="adde2ca9f86797071f6e7b2b9e779fa5e4a8f3cd"
BR2_LINUX_KERNEL_CUSTOM_VERSION=y
BR2_LINUX_KERNEL_CUSTOM_VERSION_VALUE="4.4.23"
BR2_LINUX_KERNEL_DEFCONFIG="omap2plus"
BR2_LINUX_KERNEL_DTS_SUPPORT=y
BR2_LINUX_KERNEL_INTREE_DTS_NAME="am335x-evm am335x-bone am335x-boneblack am335x-bonegreen am335x-evmsk"
BR2_PACKAGE_BUSYBOX_CONFIG="${BR2_EXTERNAL_KUBOS_LINUX_PATH}/board/kubos/generic/busybox-kubos.config"
BR2_PACKAGE_GDB=y
BR2_PACKAGE_GDB_SERVER=y
BR2_PACKAGE_GDB_DEBUGGER=y
BR2_PACKAGE_GDB_TUI=y
BR2_PACKAGE_HOST_LINUX_HEADERS_CUSTOM_4_4=y
BR2_PACKAGE_SPI_TOOLS=y
BR2_TARGET_GENERIC_GETTY_BAUDRATE_115200=y
BR2_TARGET_GENERIC_GETTY_PORT="ttyO0"
BR2_TARGET_GENERIC_ISSUE="Welcome to KubOS Linux"
BR2_TARGET_GENERIC_ROOT_PASSWD="Kubos123"
BR2_TARGET_ROOTFS_EXT2=y
BR2_TARGET_ROOTFS_EXT2_4=y
BR2_TARGET_UBOOT=y
BR2_TARGET_UBOOT_BUILD_SYSTEM_KCONFIG=y
BR2_TARGET_UBOOT_CUSTOM_VERSION=y
BR2_TARGET_UBOOT_CUSTOM_VERSION_VALUE="2016.09.01"
BR2_TARGET_UBOOT_BOARD_DEFCONFIG="am335x_evm"
BR2_TARGET_UBOOT_NEEDS_DTC=y
# BR2_TARGET_UBOOT_FORMAT_BIN is not set
BR2_TARGET_UBOOT_FORMAT_IMG=y
BR2_TARGET_UBOOT_FORMAT_CUSTOM=y
BR2_TARGET_UBOOT_FORMAT_CUSTOM_NAME="spl/u-boot-spl.bin"
BR2_TARGET_UBOOT_SPL=y
BR2_TARGET_UBOOT_SPL_NAME="MLO"
BR2_PACKAGE_HOST_DOSFSTOOLS=y
BR2_PACKAGE_HOST_GENIMAGE=y
BR2_PACKAGE_HOST_MTOOLS=y
BR2_ROOTFS_USERS_TABLES="${BR2_EXTERNAL_KUBOS_LINUX_PATH}/board/kubos/generic/users.txt"
BR2_ROOTFS_POST_IMAGE_SCRIPT="board/beaglebone/post-image.sh"
```

## configs/pumpkin-mbm2_defconfig
```kconfig
BR2_arm=y
BR2_cortex_a8=y
BR2_HOST_DIR="/usr/bin/bbb_toolchain"
BR2_TAR_OPTIONS="--no-same-owner"
BR2_GLOBAL_PATCH_DIR="${BR2_EXTERNAL_KUBOS_LINUX_PATH}/common/patches"
BR2_TOOLCHAIN_BUILDROOT_GLIBC=y
BR2_PACKAGE_HOST_LINUX_HEADERS_CUSTOM_4_4=y
BR2_BINUTILS_VERSION_2_31_X=y
BR2_TOOLCHAIN_BUILDROOT_CXX=y
BR2_GCC_ENABLE_LTO=y
BR2_PACKAGE_HOST_GDB=y
BR2_PACKAGE_HOST_GDB_SIM=y
BR2_TARGET_GENERIC_HOSTNAME="Kubos"
BR2_TARGET_GENERIC_ISSUE="Welcome to Kubos Linux"
BR2_ROOTFS_DEVICE_TABLE="system/device_table.txt $(BR2_EXTERNAL)/common/device_table.txt"
BR2_TARGET_GENERIC_ROOT_PASSWD="Kubos123"
BR2_TARGET_GENERIC_GETTY_PORT="ttyS0"
BR2_TARGET_GENERIC_GETTY_BAUDRATE_115200=y
BR2_ROOTFS_USERS_TABLES="${BR2_EXTERNAL_KUBOS_LINUX_PATH}/common/users.txt"
BR2_ROOTFS_OVERLAY="$(BR2_EXTERNAL)/common/overlay $(BR2_EXTERNAL)/board/kubos/pumpkin-mbm2/overlay"
BR2_ROOTFS_POST_IMAGE_SCRIPT="${BR2_EXTERNAL_KUBOS_LINUX_PATH}/board/kubos/pumpkin-mbm2/post-image.sh"
BR2_ROOTFS_POST_SCRIPT_ARGS="${BR2_TARGET_UBOOT_CUSTOM_REPO_VERSION}"
BR2_LINUX_KERNEL=y
BR2_LINUX_KERNEL_CUSTOM_VERSION=y
BR2_LINUX_KERNEL_CUSTOM_VERSION_VALUE="4.4.23"
BR2_LINUX_KERNEL_USE_CUSTOM_CONFIG=y
BR2_LINUX_KERNEL_CUSTOM_CONFIG_FILE="${BR2_EXTERNAL_KUBOS_LINUX_PATH}/board/kubos/pumpkin-mbm2/linux-kubos.config"
BR2_LINUX_KERNEL_CONFIG_FRAGMENT_FILES="${BR2_EXTERNAL_KUBOS_LINUX_PATH}/common/linux-kubos.config"
BR2_LINUX_KERNEL_LZ4=y
BR2_LINUX_KERNEL_DTS_SUPPORT=y
BR2_LINUX_KERNEL_USE_CUSTOM_DTS=y
BR2_LINUX_KERNEL_CUSTOM_DTS_PATH="${BR2_EXTERNAL_KUBOS_LINUX_PATH}/board/kubos/pumpkin-mbm2/pumpkin-mbm2.dts ${BR2_EXTERNAL_KUBOS_LINUX_PATH}/board/kubos/pumpkin-mbm2/am33xx-boneblack.dtsi"
BR2_LINUX_KERNEL_NEEDS_HOST_OPENSSL=y
BR2_PACKAGE_BUSYBOX_CONFIG="${BR2_EXTERNAL_KUBOS_LINUX_PATH}/common/busybox-kubos.config"
BR2_PACKAGE_BUSYBOX_SHOW_OTHERS=y
BR2_PACKAGE_GDB=y
BR2_PACKAGE_GDB_SERVER=y
BR2_PACKAGE_GDB_DEBUGGER=y
BR2_PACKAGE_GDB_TUI=y
BR2_PACKAGE_PV=y
BR2_PACKAGE_DOSFSTOOLS=y
BR2_PACKAGE_DOSFSTOOLS_FSCK_FAT=y
BR2_PACKAGE_E2FSPROGS=y
BR2_PACKAGE_E2FSPROGS_DEBUGFS=y
BR2_PACKAGE_SPI_TOOLS=y
BR2_PACKAGE_UBOOT_TOOLS=y
BR2_PACKAGE_UBOOT_TOOLS_FIT_SUPPORT=y
BR2_PACKAGE_UBOOT_TOOLS_MKIMAGE=y
BR2_PACKAGE_SQLITE=y
BR2_PACKAGE_PYTHON3=y
BR2_PACKAGE_PYTHON_NUMPY=y
BR2_PACKAGE_PYTHON_SERIAL=y
BR2_PACKAGE_PYTHON_SETUPTOOLS=y
BR2_PACKAGE_PYTHON_SMBUS_CFFI=y
BR2_PACKAGE_PYTHON_SPIDEV=y
BR2_PACKAGE_OPENSSL=y
BR2_PACKAGE_LIBCURL=y
BR2_PACKAGE_CURL=y
BR2_PACKAGE_DROPBEAR=y
BR2_PACKAGE_DROPBEAR_DISABLE_REVERSEDNS=y
BR2_PACKAGE_IFTOP=y
BR2_PACKAGE_LRZSZ=y
BR2_PACKAGE_MONIT=y
BR2_PACKAGE_RSYSLOG=y
BR2_PACKAGE_UTIL_LINUX_LIBFDISK=y
BR2_PACKAGE_UTIL_LINUX_MOUNT=y
BR2_PACKAGE_UTIL_LINUX_UUIDD=y
BR2_TARGET_ROOTFS_EXT2=y
BR2_TARGET_ROOTFS_EXT2_4=y
BR2_TARGET_ROOTFS_EXT2_LABEL="rootfs"
BR2_TARGET_ROOTFS_EXT2_SIZE="80M"
BR2_TARGET_ROOTFS_TAR_LZMA=y
BR2_TARGET_UBOOT=y
BR2_TARGET_UBOOT_BUILD_SYSTEM_KCONFIG=y
BR2_TARGET_UBOOT_CUSTOM_GIT=y
BR2_TARGET_UBOOT_CUSTOM_REPO_URL="https://github.com/kubos/uboot"
BR2_TARGET_UBOOT_CUSTOM_REPO_VERSION="1.5"
BR2_TARGET_UBOOT_USE_CUSTOM_CONFIG=y
BR2_TARGET_UBOOT_CUSTOM_CONFIG_FILE="${BR2_EXTERNAL_KUBOS_LINUX_PATH}/board/kubos/pumpkin-mbm2/pumpkin-mbm2_config"
BR2_TARGET_UBOOT_FORMAT_IMG=y
BR2_TARGET_UBOOT_SPL=y
BR2_TARGET_UBOOT_SPL_NAME="MLO"
BR2_PACKAGE_HOST_DOSFSTOOLS=y
BR2_PACKAGE_HOST_GENEXT2FS=y
BR2_PACKAGE_HOST_GENIMAGE=y
BR2_PACKAGE_HOST_MTOOLS=y
BR2_PACKAGE_KUBOS_SERVICE_LIB=y
```

## package/Config.in
```kconfig
menuconfig BR2_PACKAGE_KUBOS
	bool "KubOS Services"
	default y
	help
		Enable KubOS Linux Services

if BR2_PACKAGE_KUBOS
	source "$BR2_EXTERNAL_KUBOS_LINUX_PATH/package/kubos-telemetry/Config.in"
	source "$BR2_EXTERNAL_KUBOS_LINUX_PATH/package/kubos-c2-cli-client/Config.in"
	source "$BR2_EXTERNAL_KUBOS_LINUX_PATH/package/kubos-c2-core-library/Config.in"
	source "$BR2_EXTERNAL_KUBOS_LINUX_PATH/package/kubos-c2-daemon/Config.in"
endif
```

## package/kubos-c2-core-library/Config.in
```kconfig
config BR2_PACKAGE_KUBOS_C2_CORE_LIBRARY
	bool "Command and Control Core Command Library"
	default y
	select BR2_PACKAGE_C2_DAEMON
	help
		Include KubOS Linux Command and Control Core Command Library.
		This holds the core command implementations that are
		run by the Command and Control Daemon
```

## package/kubos-c2-daemon/Config.in
```kconfig
config BR2_PACKAGE_KUBOS_C2_DAEMON
	bool "Command and Control Daemon"
	default y
	help
		Include KubOS Linux Command and Control service.
		This service allows commands to be run through
		the command and control daemon.

config BR2_KUBOS_C2_DAEMON_INIT_LVL
	int "Command and Control Run Level"
	default 70
	range 10 99
	depends on BR2_PACKAGE_KUBOS_C2_DAEMON
	help
		The initialization priority level of the KubOS Linux
		command and control service.  The lower the number,
		the earlier the service is initi\lized.
```
