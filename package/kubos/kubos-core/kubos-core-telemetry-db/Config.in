## package/kubos/kubos-nsl-duplex/Config.in
```kconfig
menuconfig BR2_PACKAGE_KUBOS_NSL_DUPLEX
    bool "NSL Duplex Comms Service"
    default n
    select BR2_PACKAGE_HAS_KUBOS_NSL_DUPLEX
    help
        Include NSL Duplex Kubos comms service.

if BR2_PACKAGE_KUBOS_NSL_DUPLEX

config BR2_KUBOS_NSL_DUPLEX_INIT_LVL
    int "Duplex Service Run Level"
    default 90
    range 10 99
    depends on BR2_PACKAGE_KUBOS_NSL_DUPLEX
    help
        The initialization priority level of the NSL Duplex Kubos service.
        The lower the number, the earlier the service is initialized.

config BR2_KUBOS_NSL_DUPLEX_RESTART_COUNT
    int "Service Restart Limit"
    default 3
    depends on BR2_PACKAGE_KUBOS_NSL_DUPLEX
    depends on BR2_PACKAGE_MONIT
    help
        The maximum number of times the service should be restarted within the timeframe
        specified by BR2_KUBOS_NSL_DUPLEX_RESTART_CYCLES if it goes down

config BR2_KUBOS_NSL_DUPLEX_RESTART_CYCLES
    int "Service Restart Limit Timeframe"
    default 10
    depends on BR2_PACKAGE_KUBOS_NSL_DUPLEX
    depends on BR2_PACKAGE_MONIT
    help
        The number of Monit monitoring cycles in which the maximum number of service restarts
        must occur before the system stops trying to recover the service.
        
        The resulting maximum timeframe in which the restarts must occur can be calculated by
        multiplying this number by the length of a single Monit sleep cycle (60 seconds)
        
 config BR2_KUBOS_NSL_DUPLEX_IP
    string "Service GraphQL IP Address"
    default "0.0.0.0"
    depends on BR2_PACKAGE_KUBOS_NSL_DUPLEX
    help
        The IP address which the service should use to receive GraphQL requests
        
config BR2_KUBOS_NSL_DUPLEX_PORT
    int "Service GraphQL Port"
    default 8140
    depends on BR2_PACKAGE_KUBOS_NSL_DUPLEX
    help
        The port which the service should use to receive GraphQL requests

 config BR2_KUBOS_NSL_DUPLEX_COMMS_IP
    string "Comms IP Address"
    default "0.0.0.0"
    depends on BR2_PACKAGE_KUBOS_NSL_DUPLEX
    help
        The IP address which will receive intra-system messages to be downlinked
        
config BR2_KUBOS_NSL_DUPLEX_DOWNLINK_PORTS
    string "Comms Downlink Ports"
    default "[8080]"
    depends on BR2_PACKAGE_KUBOS_NSL_DUPLEX
    help
        The port/s which will receive intra-system messages to be downlinked.
        Each port should correspond to a unique way for information to be downlinked.
        
config BR2_KUBOS_NSL_DUPLEX_HANDLERS
    int "Maximum Concurrent Message Handlers"
    default 50
    depends on BR2_PACKAGE_KUBOS_NSL_DUPLEX
    help
        The maximum number of received message handlers which may be operating at one time
        
config BR2_KUBOS_NSL_DUPLEX_TIMEOUT
    int "Message Handler Timeout"
    default 1500
    depends on BR2_PACKAGE_KUBOS_NSL_DUPLEX
    help
        The length of time, in milliseconds, a message handler should wait for a reply

config BR2_KUBOS_NSL_DUPLEX_BUS
    string "UART Bus"
    default "/dev/ttyS1"
    depends on BR2_PACKAGE_KUBOS_NSL_DUPLEX
    help
        The UART bus which the NSL Duplex device is connected to

config BR2_KUBOS_NSL_DUPLEX_PING
    int "Idle Ping Frequency"
    default 10
    depends on BR2_PACKAGE_KUBOS_NSL_DUPLEX
    help
        The interval, in seconds, at which ping packets should be sent when the downlink queue is empty

endif

config BR2_PACKAGE_HAS_KUBOS_NSL_DUPLEX
    bool

config BR2_PACKAGE_PROVIDES_KUBOS_NSL_DUPLEX
    string
    default "kubos"
```

## package/kubos/kubos-pumpkin-mcu-api/Config.in
```kconfig
config BR2_PACKAGE_KUBOS_PUMPKIN_MCU_API
    bool "Pumpkin MCU Python API"
    default n
    depends on BR2_PACKAGE_PYTHON3
    select BR2_PACKAGE_KUBOS_HAL_I2C
    help
        Include the Pumpkin MCU API for Python.
```

## package/kubos/kubos-pumpkin-mcu/Config.in
```kconfig
menuconfig BR2_PACKAGE_KUBOS_PUMPKIN_MCU
    bool "Pumpkin MCU Service"
    default n
    depends on BR2_PACKAGE_PYTHON3
    select BR2_PACKAGE_PYTHON_GRAPHENE
    select BR2_PACKAGE_KUBOS_SERVICE_LIB
    select BR2_PACKAGE_KUBOS_PUMPKIN_MCU_API
    help
        Include the Pumpkin MCU Kubos Service.
        
if BR2_PACKAGE_KUBOS_PUMPKIN_MCU

config BR2_KUBOS_PUMPKIN_MCU_INIT_LVL
    int "Service Init Run Level"
    default 20
    range 10 99
    depends on BR2_PACKAGE_KUBOS_PUMPKIN_MCU
    help
        The initialization priority level of the Pumpkin MCU Kubos service.
        The lower the number, the earlier the service is initialized.

config BR2_KUBOS_PUMPKIN_MCU_IP
    string "Service IP Address"
    default "0.0.0.0"
    depends on BR2_PACKAGE_KUBOS_PUMPKIN_MCU
    help
        The IP address which the service should use to receive GraphQL requests
        
config BR2_KUBOS_PUMPKIN_MCU_PORT
    int "Service Port"
    default 8150
    depends on BR2_PACKAGE_KUBOS_PUMPKIN_MCU
    help
        The port which the service should use to receive GraphQL requests

config BR2_KUBOS_PUMPKIN_MCU_AIM2
    bool "Enable AIM2"
    depends on BR2_PACKAGE_KUBOS_PUMPKIN_MCU
    help
        Enable ADACS Interface Module 2 support

config BR2_KUBOS_PUMPKIN_MCU_AIM2_ADDR
    int "AIM2 I2C Address" if BR2_KUBOS_PUMPKIN_MCU_AIM2
    default 86
    depends on BR2_PACKAGE_KUBOS_PUMPKIN_MCU
    help
        Decimal value of the AIM2's I2C address
        
config BR2_KUBOS_PUMPKIN_MCU_BIM
    bool "Enable BIM"
    depends on BR2_PACKAGE_KUBOS_PUMPKIN_MCU
    help
        Enable Bus Interface Module support

config BR2_KUBOS_PUMPKIN_MCU_BIM_ADDR
    int "BIM I2C Address" if BR2_KUBOS_PUMPKIN_MCU_BIM
    default 82
    depends on BR2_PACKAGE_KUBOS_PUMPKIN_MCU
    help
        Decimal value of the BIM's I2C address

config BR2_KUBOS_PUMPKIN_MCU_BM2
    bool "Enable BM2"
    depends on BR2_PACKAGE_KUBOS_PUMPKIN_MCU
    help
        Enable Battery Module 2 support

config BR2_KUBOS_PUMPKIN_MCU_BM2_ADDR
    int "BM2 I2C Address" if BR2_KUBOS_PUMPKIN_MCU_BM2
    default 92
    depends on BR2_PACKAGE_KUBOS_PUMPKIN_MCU
    help
        Decimal value of the BM2's I2C address
        
config BR2_KUBOS_PUMPKIN_MCU_BSM
    bool "Enable BSM"
    depends on BR2_PACKAGE_KUBOS_PUMPKIN_MCU
    help
        Enable Battery Switch Module support

config BR2_KUBOS_PUMPKIN_MCU_BSM_ADDR
    int "BSM I2C Address" if BR2_KUBOS_PUMPKIN_MCU_BSM
    default 88
    depends on BR2_PACKAGE_KUBOS_PUMPKIN_MCU
    help
        Decimal value of the BSM's I2C address

config BR2_KUBOS_PUMPKIN_MCU_DASA
    bool "Enable DASA"
    depends on BR2_PACKAGE_KUBOS_PUMPKIN_MCU
    help
        Enable DASA support

config BR2_KUBOS_PUMPKIN_MCU_DASA_ADDR
    int "DASA I2C Address" if BR2_KUBOS_PUMPKIN_MCU_DASA
    default 93
    depends on BR2_PACKAGE_KUBOS_PUMPKIN_MCU
    help
        Decimal value of the DASA's I2C address

config BR2_KUBOS_PUMPKIN_MCU_EPSM
    bool "Enable EPSM"
    depends on BR2_PACKAGE_KUBOS_PUMPKIN_MCU
    help
        Enable EPS Module 1 support

config BR2_KUBOS_PUMPKIN_MCU_EPSM_ADDR
    int "EPSM I2C Address" if BR2_KUBOS_PUMPKIN_MCU_EPSM
    default 84
    depends on BR2_PACKAGE_KUBOS_PUMPKIN_MCU
    help
        Decimal value of the EPSM's I2C address
        
config BR2_KUBOS_PUMPKIN_MCU_GPSRM
    bool "Enable GPSRM"
    depends on BR2_PACKAGE_KUBOS_PUMPKIN_MCU
    help
        Enable GPS Receiver Module support

config BR2_KUBOS_PUMPKIN_MCU_GPSRM_ADDR
    int "GPSRM I2C Address" if BR2_KUBOS_PUMPKIN_MCU_GPSRM
    default 81
    depends on BR2_PACKAGE_KUBOS_PUMPKIN_MCU
    help
        Decimal value of the GPSRM's I2C address

config BR2_KUBOS_PUMPKIN_MCU_PIM
    bool "Enable PIM"
    depends on BR2_PACKAGE_KUBOS_PUMPKIN_MCU
    help
        Enable Payload Interface Module support

config BR2_KUBOS_PUMPKIN_MCU_PIM_ADDR
    int "PIM I2C Address" if BR2_KUBOS_PUMPKIN_MCU_PIM
    default 83
    depends on BR2_PACKAGE_KUBOS_PUMPKIN_MCU
    help
        Decimal value of the PIM's I2C address

config BR2_KUBOS_PUMPKIN_MCU_RHM
    bool "Enable RHM"
    depends on BR2_PACKAGE_KUBOS_PUMPKIN_MCU
    help
        Enable RHM support

config BR2_KUBOS_PUMPKIN_MCU_RHM_ADDR
    int "RHM I2C Address" if BR2_KUBOS_PUMPKIN_MCU_RHM
    default 85
    depends on BR2_PACKAGE_KUBOS_PUMPKIN_MCU
    help
        Decimal value of the RHM's I2C address
        
config BR2_KUBOS_PUMPKIN_MCU_SIM
    bool "Enable SIM"
    depends on BR2_PACKAGE_KUBOS_PUMPKIN_MCU
    help
        Enable Solar Interface Module support

config BR2_KUBOS_PUMPKIN_MCU_SIM_ADDR
    int "SIM I2C Address" if BR2_KUBOS_PUMPKIN_MCU_SIM
    default 80
    depends on BR2_PACKAGE_KUBOS_PUMPKIN_MCU
    help
        Decimal value of the SIM's I2C address
        
endif
```

## package/kubos/kubos-pumpkin-wdt/Config.in
```kconfig
menuconfig BR2_PACKAGE_KUBOS_PUMPKIN_WDT
    bool "Enable Pumpkin WDT Gate"
    default n
    help
        If selected, allows the Pumpkin stack's watchdog supervisor
        to trigger a reset of the MBM2 if the watchdog is starved.
        If not selected, only the peripheral devices are reset.
        
if BR2_PACKAGE_KUBOS_PUMPKIN_WDT

config BR2_KUBOS_PUMPKIN_WDT_INIT_LVL
    int "WDT Enable Run Level"
    default 10
    range 10 99
    depends on BR2_PACKAGE_KUBOS_PUMPKIN_WDT
    help
        The initialization priority level of the WDT enable script.
        The lower the number, the earlier the script is run.

endif
```

## package/kubos/kubos-service-lib/Config.in
```kconfig
config BR2_PACKAGE_KUBOS_SERVICE_LIB
    bool "Kubos Service Python Library"
    default n
    depends on BR2_PACKAGE_PYTHON3
    select BR2_PACKAGE_PYTHON_FLASK_GRAPHQL
    select BR2_PACKAGE_PYTHON_GRAPHENE
    select BR2_PACKAGE_PYTHON_TOML
    help
        Include the Kubos service library for Python.
        
        This library simplifies the process of writing servives.
        It should be included if you intend to use services which are written in Python.
```

## package/kubos/kubos-telemetry/Config.in
```kconfig
menuconfig BR2_PACKAGE_KUBOS_TELEMETRY
	bool "Telemetry"
	default y
	help
		Include KubOS Linux telemetry service.
		This service is vital for inter-system communication
		and should not be turned off!

if BR2_PACKAGE_KUBOS_TELEMETRY

config BR2_KUBOS_TELEMETRY_INIT_LVL
	int "Telemetry Run Level"
	default 70
	range 10 99
	depends on BR2_PACKAGE_KUBOS_TELEMETRY
	help
		The initialization priority level of the KubOS Linux
		telemetry service.  The lower the number, the earlier
		the service is initialized.

endif
```

## package/python-sqlalchemy/Config.in
```kconfig
config BR2_PACKAGE_PYTHON_SQLALCHEMY
	bool "python-sqlalchemy"
	help
	  SQLAlchemy is a Python SQL toolkit and ORM

	  https://www.sqlalchemy.org/
```

## package/python/Config.in
```kconfig
menu "Additional Python Packages"
    source "$BR2_EXTERNAL_KUBOS_LINUX_PATH/package/python/python-aniso8601/Config.in"
    source "$BR2_EXTERNAL_KUBOS_LINUX_PATH/package/python/python-flask_graphql/Config.in"
	source "$BR2_EXTERNAL_KUBOS_LINUX_PATH/package/python/python-graphene/Config.in"
	source "$BR2_EXTERNAL_KUBOS_LINUX_PATH/package/python/python-graphql-core/Config.in"
	source "$BR2_EXTERNAL_KUBOS_LINUX_PATH/package/python/python-graphql-relay/Config.in"
	source "$BR2_EXTERNAL_KUBOS_LINUX_PATH/package/python/python-promise/Config.in"
	source "$BR2_EXTERNAL_KUBOS_LINUX_PATH/package/python/python-rx/Config.in"
	source "$BR2_EXTERNAL_KUBOS_LINUX_PATH/package/python/python-pandas/Config.in"
	source "$BR2_EXTERNAL_KUBOS_LINUX_PATH/package/python/python-host-numpy/Config.in"
	source "$BR2_EXTERNAL_KUBOS_LINUX_PATH/package/python/python-newer-cython/Config.in"
endmenu
```

## package/python/python-adafruit_bbio/Config.in
```kconfig
config BR2_PACKAGE_PYTHON_ADAFRUIT_BBIO
	bool "python-adafruit_bbio"
	help
	  A module to control BeagleBone IO channels.

	  https://github.com/adafruit/adafruit-beaglebone-io-python/
```

## package/python/python-configparser/Config.in
```kconfig
config BR2_PACKAGE_PYTHON_CONFIGPARSER
	bool "python-configparser"
	help
	  This library brings the updated configparser from Python 3.5 to
	  Python 2.6-3.5.

	  http://docs.python.org/3/library/configparser.html
```

## package/python/python-connexion/Config.in
```kconfig
config BR2_PACKAGE_PYTHON_CONNEXION
	bool "python-connexion"
	select BR2_PACKAGE_PYTHON_CLICKCLICK # runtime
	select BR2_PACKAGE_PYTHON_JSONSCHEMA # runtime
	select BR2_PACKAGE_PYTHON_PYYAML # runtime
	select BR2_PACKAGE_PYTHON_REQUESTS # runtime
	select BR2_PACKAGE_PYTHON_SIX # runtime
	select BR2_PACKAGE_PYTHON_SWAGGER_SPEC_VALIDATOR # runtime
	select BR2_PACKAGE_PYTHON_INFLECTION # runtime
	select BR2_PACKAGE_PYTHON_PATHLIB # runtime
	select BR2_PACKAGE_PYTHON_TYPING # runtime
	select BR2_PACKAGE_PYTHON_FLASK # runtime
	help
	  Connexion - API first applications with OpenAPI/Swagger and Flask.

	  https://github.com/zalando/connexion
```

## package/python/python-flask_graphql/Config.in
```kconfig
config BR2_PACKAGE_PYTHON_FLASK_GRAPHQL
	bool "python-flask_graphql"
	default n
	select BR2_PACKAGE_PYTHON_GRAPHQL_CORE # runtime
	select BR2_PACKAGE_PYTHON_GRAPHQL_SERVER_CORE # runtime
	select BR2_PACKAGE_PYTHON_FLASK # runtime
	help
	  Adds GraphQL support to your Flask application.

	  https://github.com/graphql-python/flask-graphql
```

## package/python/python-graphene-sqlalchemy/Config.in
```kconfig
config BR2_PACKAGE_PYTHON_GRAPHENE_SQLALCHEMY
	bool "python-graphene-sqlalchemy"
	select BR2_PACKAGE_PYTHON_SQLALCHEMY
	select BR2_PACKAGE_PYTHON_SIX
	select BR2_PACKAGE_PYTHON_SINGLEDISPATCH
	select BR2_PACKAGE_PYTHON_GRAPHENE
	help
	  SQLAlchemy integration for Graphene

	  https://github.com/graphql-python/graphene-sqlalchemy
```

## package/python/python-graphene/Config.in
```kconfig
config BR2_PACKAGE_PYTHON_GRAPHENE
	bool "python-graphene"
	select BR2_PACKAGE_PYTHON_SIX # runtime
	select BR2_PACKAGE_PYTHON_GRAPHQL_CORE # runtime
	select BR2_PACKAGE_PYTHON_GRAPHQL_RELAY # runtime
	select BR2_PACKAGE_PYTHON_PROMISE # runtime
	select BR2_PACKAGE_PYTHON_ANISO8601 # runtime
	help
	  GraphQL Framework for Python.

	  https://github.com/graphql-python/graphene
```

## package/python/python-graphql-core/Config.in
```kconfig
config BR2_PACKAGE_PYTHON_GRAPHQL_CORE
	bool "python-graphql-core"
	select BR2_PACKAGE_PYTHON_SIX # runtime
	select BR2_PACKAGE_PYTHON_PROMISE # runtime
	select BR2_PACKAGE_PYTHON_RX # runtime
	help
	  GraphQL implementation for Python.

	  https://github.com/graphql-python/graphql-core
```

## package/python/python-graphql-relay/Config.in
```kconfig
config BR2_PACKAGE_PYTHON_GRAPHQL_RELAY
	bool "python-graphql-relay"
	select BR2_PACKAGE_PYTHON_SIX # runtime
	select BR2_PACKAGE_PYTHON_GRAPHQL_CORE # runtime
	select BR2_PACKAGE_PYTHON_PROMISE # runtime
	help
	  Relay implementation for Python.

	  https://github.com/graphql-python/graphql-relay-py
```

## package/python/python-graphql-server-core/Config.in
```kconfig
config BR2_PACKAGE_PYTHON_GRAPHQL_SERVER_CORE
	bool "python-graphql-server-core"
	select BR2_PACKAGE_PYTHON_GRAPHQL_CORE # runtime
	select BR2_PACKAGE_PYTHON_PROMISE # runtime
	help
	  GraphQL Server tools for powering your server.

	  https://github.com/graphql-python/graphql-server-core
```

## package/python/python-logging/Config.in
```kconfig
config BR2_PACKAGE_PYTHON_LOGGING
	bool "python-logging"
	help
	  A logging module for Python.

	  http://www.red-dove.com/python_logging.html
```

## package/python/python-newer-cython/Config.in
```kconfig
config BR2_PACKAGE_HOST_PYTHON_NEWER_CYTHON
	bool "host python-newer-cython"
	help
	  The Cython compiler for writing C extensions for the Python
	  language.

	  http://cython.org/
```
