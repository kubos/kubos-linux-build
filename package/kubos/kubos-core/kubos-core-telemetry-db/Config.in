## package/kubos/kubos-core/kubos-core-telemetry-db/Config.in
```kconfig
menuconfig BR2_PACKAGE_KUBOS_CORE_TELEMETRY_DB
    bool "Telemetry Database Service"
    default n
    select BR2_PACKAGE_SQLITE
    select BR2_PACKAGE_HAS_KUBOS_CORE_TELEMETRY_DB
    help
        Include Kubos telemetry database service.

if BR2_PACKAGE_KUBOS_CORE_TELEMETRY_DB

config BR2_KUBOS_CORE_TELEMETRY_DB_INIT_LVL
    int "Telemetry Database Service Init Level"
    default 90
    range 10 99
    depends on BR2_PACKAGE_KUBOS_CORE_TELEMETRY_DB
    help
        The initialization priority level of the telemetry database service.
        The lower the number, the earlier the service is initialized.

config BR2_KUBOS_CORE_TELEMETRY_DB_RESTART_COUNT
    int "Telemetry Database Service Restart Limit"
    default 3
    depends on BR2_PACKAGE_KUBOS_CORE_TELEMETRY_DB
    depends on BR2_PACKAGE_MONIT
    help
        The maximum number of times the service should be restarted within the timeframe
        specified by BR2_KUBOS_CORE_TELEMETRY_DB_RESTART_CYCLES if it goes down

config BR2_KUBOS_CORE_TELEMETRY_DB_RESTART_CYCLES
    int "Telemetry Database Service Restart Limit Timeframe"
    default 10
    depends on BR2_PACKAGE_KUBOS_CORE_TELEMETRY_DB
    depends on BR2_PACKAGE_MONIT
    help
        The number of Monit monitoring cycles in which the maximum number of service restarts
        must occur before the system stops trying to recover the service.
        
        The resulting maximum timeframe in which the restarts must occur can be calculated by
        multiplying this number by the length of a single Monit sleep cycle (60 seconds)

config BR2_KUBOS_CORE_TELEMETRY_DB_IP
    string "Telemetry Database Service IP Address"
    default "0.0.0.0"
    depends on BR2_PACKAGE_KUBOS_CORE_TELEMETRY_DB
    help
        The IP address which the telemetry database service should use to receive GraphQL requests
        
config BR2_KUBOS_CORE_TELEMETRY_DB_PORT
    int "Telemetry Database Service Port"
    default 8020
    depends on BR2_PACKAGE_KUBOS_CORE_TELEMETRY_DB
    help
        The port which the telemetry database service should use to receive GraphQL requests

config BR2_KUBOS_CORE_TELEMETRY_DB_DATABASE
    string "Telemetry Database Location"
    default "/home/system/kubos/telemetry.db"
    depends on BR2_PACKAGE_KUBOS_CORE_TELEMETRY_DB
    help
        The location of the telemetry database
        
config BR2_KUBOS_CORE_TELEMETRY_DB_DIRECT_PORT
    int "Telemetry Database Service Port"
    default 8021
    depends on BR2_PACKAGE_KUBOS_CORE_TELEMETRY_DB
    help
        The UDP port which should be used for receiving asynchronous/bulk telemetry insert requests
        
endif

config BR2_PACKAGE_HAS_KUBOS_CORE_TELEMETRY_DB
    bool

config BR2_PACKAGE_PROVIDES_KUBOS_CORE_TELEMETRY_DB
    string
    default "kubos"
```

## package/kubos/kubos-hal-i2c/Config.in
```kconfig
config BR2_PACKAGE_KUBOS_HAL_I2C
    bool "Python I2C HAL"
    default y
    depends on BR2_PACKAGE_PYTHON3
    help
        Include the Kubos I2C HAL for Python.
```

## package/kubos/kubos-isis-ants/Config.in
```kconfig
menuconfig BR2_PACKAGE_KUBOS_ISIS_ANTS
    bool "ISIS Antenna Systems Service"
    default n
    select BR2_PACKAGE_HAS_KUBOS_ISIS_ANTS
    help
        Include ISIS AntS Kubos service.

if BR2_PACKAGE_KUBOS_ISIS_ANTS

config BR2_KUBOS_ISIS_ANTS_INIT_LVL
    int "ISIS AntS Service Run Level"
    default 90
    range 10 99
    depends on BR2_PACKAGE_KUBOS_ISIS_ANTS
    help
        The initialization priority level of the ISIS AntS Kubos service.
        The lower the number, the earlier the service is initialized.

config BR2_KUBOS_ISIS_ANTS_RESTART_COUNT
    int "Service Restart Limit"
    default 3
    depends on BR2_PACKAGE_KUBOS_ISIS_ANTS
    depends on BR2_PACKAGE_MONIT
    help
        The maximum number of times the service should be restarted within the timeframe
        specified by BR2_KUBOS_ISIS_ANTS_RESTART_CYCLES if it goes down

config BR2_KUBOS_ISIS_ANTS_RESTART_CYCLES
    int "Service Restart Limit Timeframe"
    default 10
    depends on BR2_PACKAGE_KUBOS_ISIS_ANTS
    depends on BR2_PACKAGE_MONIT
    help
        The number of Monit monitoring cycles in which the maximum number of service restarts
        must occur before the system stops trying to recover the service.
        
        The resulting maximum timeframe in which the restarts must occur can be calculated by
        multiplying this number by the length of a single Monit sleep cycle (60 seconds)
 
 config BR2_KUBOS_ISIS_ANTS_IP
    string "Service IP Address"
    default "0.0.0.0"
    depends on BR2_PACKAGE_KUBOS_ISIS_ANTS
    help
        The IP address which the service should use to receive GraphQL requests
        
config BR2_KUBOS_ISIS_ANTS_PORT
    int "Service Port"
    default 8110
    depends on BR2_PACKAGE_KUBOS_ISIS_ANTS
    help
        The port which the service should use to receive GraphQL requests   
           
config BR2_KUBOS_ISIS_ANTS_BUS
    string "I2C Bus"
    default "/dev/i2c-0"
    depends on BR2_PACKAGE_KUBOS_ISIS_ANTS
    help
        The I2C bus the antenna device is connected to
           
config BR2_KUBOS_ISIS_ANTS_PRIMARY
    string "Primary Controller I2C Address"
    default "0x31"
    depends on BR2_PACKAGE_KUBOS_ISIS_ANTS
    help
        The I2C address of the primary antenna controller
           
config BR2_KUBOS_ISIS_ANTS_SECONDARY
    string "Secondary Controller I2C Address"
    default "0x32"
    depends on BR2_PACKAGE_KUBOS_ISIS_ANTS
    help
        The I2C address of the secondary microcontroller.
        If no secondary contoller is present, this value should be "0x00".
           
config BR2_KUBOS_ISIS_ANTS_COUNT
    int "Number of Antennas"
    default 4
    depends on BR2_PACKAGE_KUBOS_ISIS_ANTS
    help
        The number of antennas present in the system. Expected value: 2 or 4.
           
config BR2_KUBOS_ISIS_ANTS_WDT
    int "Watchdog Timeout"
    default 10
    depends on BR2_PACKAGE_KUBOS_ISIS_ANTS
    help
        The interval, in seconds, at which the antenna system's watchdog should be automatically kicked.
        To disable automatic kicking, this value should be 0.
             
endif

config BR2_PACKAGE_HAS_KUBOS_ISIS_ANTS
    bool

config BR2_PACKAGE_PROVIDES_KUBOS_ISIS_ANTS
    string
    default "kubos"
```

## package/kubos/kubos-mai400/Config.in
```kconfig
menuconfig BR2_PACKAGE_KUBOS_MAI400
    bool "MAI-400 Service"
    default n
    select BR2_PACKAGE_HAS_KUBOS_MAI400
    help
        Include MAI-400 Kubos service.

if BR2_PACKAGE_KUBOS_MAI400

config BR2_KUBOS_MAI400_INIT_LVL
    int "MAI-400 Service Run Level"
    default 90
    range 10 99
    depends on BR2_PACKAGE_KUBOS_MAI400
    help
        The initialization priority level of the MAI-400 Kubos service.
        The lower the number, the earlier the service is initialized.

config BR2_KUBOS_MAI400_RESTART_COUNT
    int "Service Restart Limit"
    default 3
    depends on BR2_PACKAGE_KUBOS_MAI400
    depends on BR2_PACKAGE_MONIT
    help
        The maximum number of times the service should be restarted within the timeframe
        specified by BR2_KUBOS_MAI400_RESTART_CYCLES if it goes down

config BR2_KUBOS_MAI400_RESTART_CYCLES
    int "Service Restart Limit Timeframe"
    default 10
    depends on BR2_PACKAGE_KUBOS_MAI400
    depends on BR2_PACKAGE_MONIT
    help
        The number of Monit monitoring cycles in which the maximum number of service restarts
        must occur before the system stops trying to recover the service.
        
        The resulting maximum timeframe in which the restarts must occur can be calculated by
        multiplying this number by the length of a single Monit sleep cycle (60 seconds)
 
config BR2_KUBOS_MAI400_IP
    string "Service IP Address"
    default "0.0.0.0"
    depends on BR2_PACKAGE_KUBOS_MAI400
    help
        The IP address which the service should use to receive GraphQL requests
        
config BR2_KUBOS_MAI400_PORT
    int "Service Port"
    default 8120
    depends on BR2_PACKAGE_KUBOS_MAI400
    help
        The port which the service should use to receive GraphQL requests
        
endif

config BR2_PACKAGE_HAS_KUBOS_MAI400
    bool

config BR2_PACKAGE_PROVIDES_KUBOS_MAI400
    string
    default "kubos"
```

## package/kubos/kubos-monitor/Config.in
```kconfig
menuconfig BR2_PACKAGE_KUBOS_MONITOR
    bool "Monitor Service"
    default y
    select BR2_PACKAGE_HAS_KUBOS_MONITOR
    help
        Include Kubos monitor service.
        
        This service provides the ability to query the OBC's current processes and memory usage

if BR2_PACKAGE_KUBOS_MONITOR

config BR2_KUBOS_MONITOR_INIT_LVL
    int "Monitor Service Init Level"
    default 90
    range 10 99
    depends on BR2_PACKAGE_KUBOS_MONITOR
    help
        The initialization priority level of the Kubos service.
        The lower the number, the earlier the service is initialized.

config BR2_KUBOS_MONITOR_RESTART_COUNT
    int "Service Restart Limit"
    default 3
    depends on BR2_PACKAGE_KUBOS_MONITOR
    depends on BR2_PACKAGE_MONIT
    help
        The maximum number of times the service should be restarted within the timeframe
        specified by BR2_KUBOS_MONITOR_RESTART_CYCLES if it goes down

config BR2_KUBOS_MONITOR_RESTART_CYCLES
    int "Service Restart Limit Timeframe"
    default 10
    depends on BR2_PACKAGE_KUBOS_MONITOR
    depends on BR2_PACKAGE_MONIT
    help
        The number of Monit monitoring cycles in which the maximum number of service restarts
        must occur before the system stops trying to recover the service.
        
        The resulting maximum timeframe in which the restarts must occur can be calculated by
        multiplying this number by the length of a single Monit sleep cycle (60 seconds)
            
config BR2_KUBOS_MONITOR_IP
    string "Service IP Address"
    default "0.0.0.0"
    depends on BR2_PACKAGE_KUBOS_MONITOR
    help
        The IP address which the service should use to receive GraphQL requests
        
config BR2_KUBOS_MONITOR_PORT
    int "Service Port"
    default 8030
    depends on BR2_PACKAGE_KUBOS_MONITOR
    help
        The port which the service should use to receive GraphQL requests  
        
endif

config BR2_PACKAGE_HAS_KUBOS_MONITOR
    bool

config BR2_PACKAGE_PROVIDES_KUBOS_MONITOR
    string
    default "kubos"
```

## package/kubos/kubos-novatel-oem6/Config.in
```kconfig
menuconfig BR2_PACKAGE_KUBOS_NOVATEL_OEM6
    bool "NovAtel OEM6 Service"
    default n
    select BR2_PACKAGE_HAS_KUBOS_NOVATEL_OEM6
    help
        Include NovAtel OEM6 Kubos service.

if BR2_PACKAGE_KUBOS_NOVATEL_OEM6

config BR2_KUBOS_NOVATEL_OEM6_INIT_LVL
    int "OEM6 Service Run Level"
    default 90
    range 10 99
    depends on BR2_PACKAGE_KUBOS_NOVATEL_OEM6
    help
        The initialization priority level of the OEM6 Kubos service.
        The lower the number, the earlier the service is initialized.

config BR2_KUBOS_NOVATEL_OEM6_RESTART_COUNT
    int "Service Restart Limit"
    default 3
    depends on BR2_PACKAGE_KUBOS_NOVATEL_OEM6
    depends on BR2_PACKAGE_MONIT
    help
        The maximum number of times the service should be restarted within the timeframe
        specified by BR2_KUBOS_NOVATEL_OEM6_RESTART_CYCLES if it goes down

config BR2_KUBOS_NOVATEL_OEM6_RESTART_CYCLES
    int "Service Restart Limit Timeframe"
    default 10
    depends on BR2_PACKAGE_KUBOS_NOVATEL_OEM6
    depends on BR2_PACKAGE_MONIT
    help
        The number of Monit monitoring cycles in which the maximum number of service restarts
        must occur before the system stops trying to recover the service.
        
        The resulting maximum timeframe in which the restarts must occur can be calculated by
        multiplying this number by the length of a single Monit sleep cycle (60 seconds)

config BR2_KUBOS_NOVATEL_OEM6_IP
    string "Service IP Address"
    default "0.0.0.0"
    depends on BR2_PACKAGE_KUBOS_NOVATEL_OEM6
    help
        The IP address which the service should use to receive GraphQL requests
        
config BR2_KUBOS_NOVATEL_OEM6_PORT
    int "Service Port"
    default 8130
    depends on BR2_PACKAGE_KUBOS_NOVATEL_OEM6
    help
        The port which the service should use to receive GraphQL requests

config BR2_KUBOS_NOVATEL_OEM6_BUS
    string "UART Bus"
    default "/dev/ttyS4"
    depends on BR2_PACKAGE_KUBOS_NOVATEL_OEM6
    help
        The UART bus which the OEM6 device is connected to

endif

config BR2_PACKAGE_HAS_KUBOS_NOVATEL_OEM6
    bool

config BR2_PACKAGE_PROVIDES_KUBOS_NOVATEL_OEM6
    string
    default "kubos"
```
