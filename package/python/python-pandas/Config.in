## package/python/python-pandas/Config.in
```kconfig
config BR2_PACKAGE_PYTHON_PANDAS
	bool "python-pandas"
	select BR2_PACKAGE_HOST_PYTHON_NEWER_CYTHON
	select BR2_PACKAGE_HOST_PYTHON_NUMPY
	help
	  Practical, real-world data analysis in Python

	  https://pandas.pydata.org/
```

## package/python/python-pathlib/Config.in
```kconfig
config BR2_PACKAGE_PYTHON_PATHLIB
	bool "python-pathlib"
	help
	  Object-oriented filesystem paths.

	  https://pathlib.readthedocs.org/
```

## package/python/python-promise/Config.in
```kconfig
config BR2_PACKAGE_PYTHON_PROMISE
	bool "python-promise"
	select BR2_PACKAGE_PYTHON_SIX # runtime
	help
	  Promises/A+ implementation for Python.

	  https://github.com/syrusakbary/promise
```

## package/python/python-rx/Config.in
```kconfig
config BR2_PACKAGE_PYTHON_RX
	bool "python-rx"
	help
	  Reactive Extensions (Rx) for Python.

	  http://reactivex.io
```

## package/python/python-sqlalchemy/Config.in
```kconfig
config BR2_PACKAGE_PYTHON_SQLALCHEMY
	bool "python-sqlalchemy"
	help
	  Database Abstraction Library.

	  http://www.sqlalchemy.org
```

## package/python/python-swagger-spec-validator/Config.in
```kconfig
config BR2_PACKAGE_PYTHON_SWAGGER_SPEC_VALIDATOR
	bool "python-swagger-spec-validator"
	select BR2_PACKAGE_PYTHON_JSONSCHEMA # runtime
	select BR2_PACKAGE_PYTHON_SIX # runtime
	help
	  Validation of Swagger specifications.

	  http://github.com/Yelp/swagger_spec_validator
```

## tools/kpack.its
```
/*
 * Copyright (C) 2017 Kubos Corporation
 *
 * Licensed under the Apache License, Version 2.0 (the "License");
 * you may not use this file except in compliance with the License.
 * You may obtain a copy of the License at
 *
 *     http://www.apache.org/licenses/LICENSE-2.0
 *
 * Unless required by applicable law or agreed to in writing, software
 * distributed under the License is distributed on an "AS IS" BASIS,
 * WITHOUT WARRANTIES OR CONDITIONS OF ANY KIND, either express or implied.
 * See the License for the specific language governing permissions and
 * limitations under the License.
 *
 * Kubos Linux Upgrade Package
 * Contains: New kernel and rootfs image
 */

/dts-v1/;

/ {
	description = "Kubos Linux Upgrade Package";
	#address-cells = <1>;

	images {
		kernel@1 {
			data = /incbin/("./kernel");
			type = "firmware";
			arch = "arm";
			os = "linux";
			compression = "none";
			load = <00000000>;
			entry = <00000000>;
			hash@1 {
				algo = "sha256";
			};
		};
		rootfs@1 {
			data = /incbin/("./rootfs.img");
			type = "firmware";
			arch = "arm";
			os = "linux";
			compression = "none";
			load = <00000000>;
			entry = <00000000>;
			hash@1 {
				algo = "sha256";
			};
		};
	};

	configurations {
		default = "config@1";
		config@1 {
			description = "Full Kubos Linux Upgrade";
			kernel = "kernel@1";
			rootfs = "rootfs@1";
		};
	};
};
```
